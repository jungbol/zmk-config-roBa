## boards/shields/roBa/dts/bindings/input_processor_acceleration.yaml
```yaml
description: Custom input processor for acceleration

compatible: "zmk,input-processor-acceleration"

include: base.yaml

properties:
  acceleration-exponent:
    type: int
    required: true

  acceleration-coefficient:
    type: int
    required: true

# 🔥 이거 없으면 지금처럼 터짐
input-processor-cells: 0
```

## config/dts/bindings/input_processor_acceleration.yaml
```yaml
description: Custom input processor for acceleration

compatible: "zmk,input-processor-acceleration"

include: base.yaml

properties:
  acceleration-exponent:
    type: int
    required: true

  acceleration-coefficient:
    type: int
    required: true

# 🔥 반드시 이렇게
input-processor-cells: []
```

## config/west.yml
```yaml
manifest:
  remotes:
    - name: zmkfirmware
      url-base: https://github.com/zmkfirmware
    - name: kumamuk-git
      url-base: https://github.com/kumamuk-git
    # urob 원격지 설정은 삭제해도 됩니다.

  projects:
    - name: zmk
      remote: zmkfirmware
      revision: v0.3-branch
      import: app/west.yml
    - name: zmk-pmw3610-driver
      remote: kumamuk-git
      revision: main
    # 아래처럼 'url' 항목을 직접 사용하고, 주소 뒤에 '.git'을 붙여보세요.
    - name: zmk-input-behavior-listener
      url: https://github.com/urob/zmk-input-behavior-listener.git
      revision: main

  self:
    path: config
```

## modules/accel/dts/bindings/zmk,input-processor-acceleration.yaml
```yaml
description: Custom input processor for acceleration

compatible: "zmk,input-processor-acceleration"

include: base.yaml

properties:
  acceleration-exponent:
    type: int
    required: true

  acceleration-coefficient:
    type: int
    required: true

# 🔥 이게 정답 (아무 값도 넣지 않음)
input-processor-cells:
```
